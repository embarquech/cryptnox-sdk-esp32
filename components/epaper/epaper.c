#include "epaper.h"
#include "freertos/FreeRTOS.h"
#include "freertos/task.h"
#include "esp_log.h"
#include <string.h>

static const char *TAG = "epaper";

// SSD1680 commands
#define CMD_DRIVER_OUTPUT_CTRL     0x01
#define CMD_DATA_ENTRY_MODE        0x11
#define CMD_SW_RESET               0x12
#define CMD_TEMP_SENSOR_CTRL       0x18
#define CMD_MASTER_ACTIVATION      0x20
#define CMD_DISPLAY_UPDATE_CTRL1   0x21
#define CMD_DISPLAY_UPDATE_CTRL2   0x22
#define CMD_WRITE_RAM_BW           0x24
#define CMD_BORDER_WAVEFORM_CTRL   0x3C
#define CMD_SET_RAMX_ADDR          0x44
#define CMD_SET_RAMY_ADDR          0x45
#define CMD_SET_RAMX_COUNTER       0x4E
#define CMD_SET_RAMY_COUNTER       0x4F
#define CMD_ANALOG_BLOCK_CTRL      0x74
#define CMD_DIGITAL_BLOCK_CTRL     0x7E

// 5x7 font for ASCII 32–126
static const uint8_t font5x7[][5] = {
    {0x00,0x00,0x00,0x00,0x00}, // ' '
    {0x00,0x00,0x5F,0x00,0x00}, // '!'
    {0x00,0x07,0x00,0x07,0x00}, // '"'
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    {0x10,0x08,0x08,0x10,0x08}, // '~'
};

static void spi_send(epaper_t *dev, bool is_data, const uint8_t *data, size_t len)
{
    gpio_set_level(dev->pin_dc, is_data ? 1 : 0);
    spi_transaction_t t = {
        .length = len * 8,
        .tx_buffer = data,
    };
    spi_device_polling_transmit(dev->spi, &t);
}

static void send_cmd(epaper_t *dev, uint8_t cmd)
{
    spi_send(dev, false, &cmd, 1);
}

static void send_data(epaper_t *dev, uint8_t data)
{
    spi_send(dev, true, &data, 1);
}

static void wait_busy(epaper_t *dev)
{
    while (gpio_get_level(dev->pin_busy)) {
        vTaskDelay(pdMS_TO_TICKS(10));
    }
}

static void hw_reset(epaper_t *dev)
{
    gpio_set_level(dev->pin_rst, 1);
    vTaskDelay(pdMS_TO_TICKS(10));
    gpio_set_level(dev->pin_rst, 0);
    vTaskDelay(pdMS_TO_TICKS(10));
    gpio_set_level(dev->pin_rst, 1);
    vTaskDelay(pdMS_TO_TICKS(10));
}

static void set_ram_window(epaper_t *dev)
{
    // X: 0 to (WIDTH/8 - 1)
    send_cmd(dev, CMD_SET_RAMX_ADDR);
    send_data(dev, 0x00);
    send_data(dev, (EPAPER_HEIGHT / 8) - 1);

    // Y: 0 to (WIDTH - 1)
    send_cmd(dev, CMD_SET_RAMY_ADDR);
    send_data(dev, 0x00);
    send_data(dev, 0x00);
    send_data(dev, (EPAPER_WIDTH - 1) & 0xFF);
    send_data(dev, (EPAPER_WIDTH - 1) >> 8);
}

static void set_ram_cursor(epaper_t *dev)
{
    send_cmd(dev, CMD_SET_RAMX_COUNTER);
    send_data(dev, 0x00);

    send_cmd(dev, CMD_SET_RAMY_COUNTER);
    send_data(dev, 0x00);
    send_data(dev, 0x00);
}

esp_err_t epaper_init(epaper_t *dev, const epaper_config_t *cfg)
{
    dev->pin_cs   = cfg->pin_cs;
    dev->pin_dc   = cfg->pin_dc;
    dev->pin_rst  = cfg->pin_rst;
    dev->pin_busy = cfg->pin_busy;

    // Configure output GPIOs
    gpio_config_t out_cfg = {
        .pin_bit_mask = (1ULL << cfg->pin_dc) | (1ULL << cfg->pin_rst),
        .mode = GPIO_MODE_OUTPUT,
    };
    gpio_config(&out_cfg);

    // Configure BUSY as input
    gpio_config_t in_cfg = {
        .pin_bit_mask = (1ULL << cfg->pin_busy),
        .mode = GPIO_MODE_INPUT,
    };
    gpio_config(&in_cfg);

    // SPI bus init
    spi_bus_config_t bus = {
        .mosi_io_num     = cfg->pin_mosi,
        .miso_io_num     = -1,
        .sclk_io_num     = cfg->pin_sck,
        .quadwp_io_num   = -1,
        .quadhd_io_num   = -1,
        .max_transfer_sz = EPAPER_BUF_SIZE,
    };
    esp_err_t ret = spi_bus_initialize(cfg->spi_host, &bus, SPI_DMA_CH_AUTO);
    if (ret != ESP_OK) {
        ESP_LOGE(TAG, "SPI bus init failed: %s", esp_err_to_name(ret));
        return ret;
    }

    spi_device_interface_config_t devcfg = {
        .clock_speed_hz = 4 * 1000 * 1000,
        .mode           = 0,
        .spics_io_num   = cfg->pin_cs,
        .queue_size     = 1,
    };
    ret = spi_bus_add_device(cfg->spi_host, &devcfg, &dev->spi);
    if (ret != ESP_OK) {
        ESP_LOGE(TAG, "SPI device add failed: %s", esp_err_to_name(ret));
        return ret;
    }

    // Hardware reset and SSD1680 init sequence
    hw_reset(dev);
    wait_busy(dev);

    send_cmd(dev, CMD_SW_RESET);
    wait_busy(dev);

    send_cmd(dev, CMD_ANALOG_BLOCK_CTRL);
    send_data(dev, 0x54);

    send_cmd(dev, CMD_DIGITAL_BLOCK_CTRL);
    send_data(dev, 0x3B);

    send_cmd(dev, CMD_DRIVER_OUTPUT_CTRL);
    send_data(dev, (EPAPER_WIDTH - 1) & 0xFF);
    send_data(dev, (EPAPER_WIDTH - 1) >> 8);
    send_data(dev, 0x00);

    send_cmd(dev, CMD_DATA_ENTRY_MODE);
    send_data(dev, 0x03); // x-increment, y-increment

    set_ram_window(dev);

    send_cmd(dev, CMD_BORDER_WAVEFORM_CTRL);
    send_data(dev, 0x05);

    send_cmd(dev, CMD_TEMP_SENSOR_CTRL);
    send_data(dev, 0x80); // use internal sensor

    send_cmd(dev, CMD_DISPLAY_UPDATE_CTRL1);
    send_data(dev, 0x00);
    send_data(dev, 0x80);

    set_ram_cursor(dev);
    wait_busy(dev);

    memset(dev->buf, 0xFF, EPAPER_BUF_SIZE); // white
    ESP_LOGI(TAG, "E-paper initialized (SSD1680, %dx%d)", EPAPER_WIDTH, EPAPER_HEIGHT);
    return ESP_OK;
}

void epaper_clear(epaper_t *dev, uint8_t color)
{
    memset(dev->buf, color ? 0xFF : 0x00, EPAPER_BUF_SIZE);
}

// Draw one pixel into the framebuffer (x: 0..WIDTH-1, y: 0..HEIGHT-1)
static void draw_pixel(epaper_t *dev, int x, int y)
{
    if (x < 0 || x >= EPAPER_WIDTH || y < 0 || y >= EPAPER_HEIGHT) return;
    // Landscape: WIDTH=296 horizontal, HEIGHT=128 vertical
    // byte index: each row has WIDTH/8 bytes, pixel x is in column x, row y
    int byte_idx = (y / 8) + (x * (EPAPER_HEIGHT / 8));
    int bit_pos  = 7 - (y % 8);
    dev->buf[byte_idx] &= ~(1 << bit_pos); // clear bit = black pixel
}

void epaper_draw_char(epaper_t *dev, int x, int y, char c)
{
    if (c < 32 || c > 126) c = ' ';
    const uint8_t *glyph = font5x7[c - 32];
    for (int col = 0; col < 5; col++) {
        uint8_t column = glyph[col];
        for (int row = 0; row < 7; row++) {
            if (column & (1 << row)) {
                draw_pixel(dev, x + col, y + row);
            }
        }
    }
}

void epaper_draw_string(epaper_t *dev, int x, int y, const char *str)
{
    while (*str) {
        epaper_draw_char(dev, x, y, *str++);
        x += 6; // 5px glyph + 1px spacing
    }
}

void epaper_refresh(epaper_t *dev)
{
    set_ram_cursor(dev);

    send_cmd(dev, CMD_WRITE_RAM_BW);
    spi_send(dev, true, dev->buf, EPAPER_BUF_SIZE);

    send_cmd(dev, CMD_DISPLAY_UPDATE_CTRL2);
    send_data(dev, 0xF7);

    send_cmd(dev, CMD_MASTER_ACTIVATION);
    wait_busy(dev);
    ESP_LOGI(TAG, "Display refreshed");
}

void epaper_sleep(epaper_t *dev)
{
    send_cmd(dev, 0x10); // deep sleep
    send_data(dev, 0x01);
}

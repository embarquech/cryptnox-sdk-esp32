## examples/usdc_signing/sdkconfig.defaults
```kconfig
CONFIG_IDF_TARGET="esp32s3"

# Enough stack for TLS + JSON + crypto operations in app_main
CONFIG_ESP_MAIN_TASK_STACK_SIZE=16384

# mbedTLS certificate bundle for HTTPS RPC endpoints
CONFIG_MBEDTLS_CERTIFICATE_BUNDLE=y
CONFIG_MBEDTLS_CERTIFICATE_BUNDLE_DEFAULT_FULL=y

# HTTPS support in the HTTP client
CONFIG_ESP_HTTP_CLIENT_ENABLE_HTTPS=y
```

## sdkconfig.defaults
```kconfig
CONFIG_IDF_TARGET="esp32s3"

# ── Main task stack ─────────────────────────────────────────────────────────
# The secure channel protocol (ECDH, AES, SHA-512) together with the PN532
# extended-frame buffer allocates >3 KB on the call stack.  8 KB gives
# comfortable headroom for the deepest call path (pn532_send_apdu inside
# mutuallyAuthenticate inside app_main).
CONFIG_ESP_MAIN_TASK_STACK_SIZE=8192

# ── Security hardening (SEC-003) ────────────────────────────────────────────
# Flash Encryption and Secure Boot V2 must be enabled on production hardware.
#
# WARNING: These settings involve one-time eFuse programming.
# Read the provisioning guide in the Security section of README.md before
# enabling them on real hardware.  They are safe to enable here because
# ESP-IDF only performs the actual eFuse writes during the first boot of a
# freshly provisioned device.
#
# Flash Encryption — encrypts all SPI flash content so a USB cable cannot
# be used to extract firmware or hard-coded secrets.
CONFIG_SECURE_FLASH_ENC_ENABLED=y
CONFIG_SECURE_FLASH_ENCRYPTION_MODE_RELEASE=y
#
# Secure Boot V2 — verifies the bootloader and application image signature
# on every boot, preventing reflashing of tampered firmware.
CONFIG_SECURE_BOOT=y
CONFIG_SECURE_BOOT_V2_ENABLED=y
CONFIG_SECURE_BOOT_BUILD_SIGNED_BINARIES=y
```
